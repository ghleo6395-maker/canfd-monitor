VERSION "Rev D simulator review example (original test data)"
NS_ :

BS_:
BU_: DemoNode

BO_ 291 VehicleStatus: 8 DemoNode
 SG_ Speed : 0|16@1+ (0.1,0) [0|6553.5] "km/h" DemoNode
BO_ 2566869221 ExtendedStatus: 8 DemoNode
 SG_ Counter : 0|8@1+ (1,0) [0|255] "" DemoNode
BO_ 929 FdPayload: 64 DemoNode
 SG_ FirstByte : 0|8@1+ (1,0) [0|255] "" DemoNode
 SG_ LastByte : 504|8@1+ (1,0) [0|255] "" DemoNode

BA_DEF_ BO_ "GenMsgCycleTime" INT 0 65535;
BA_DEF_ BO_ "VFrameFormat" ENUM "StandardCAN","ExtendedCAN","reserved","J1939PG","reserved","reserved","reserved","reserved","reserved","reserved","reserved","reserved","reserved","reserved","StandardCAN_FD","ExtendedCAN_FD";
BA_DEF_ BO_ "CANFD_BRS" INT 0 1;
BA_ "GenMsgCycleTime" BO_ 291 100;
BA_ "GenMsgCycleTime" BO_ 2566869221 500;
BA_ "GenMsgCycleTime" BO_ 929 20;
BA_ "VFrameFormat" BO_ 291 0;
BA_ "VFrameFormat" BO_ 2566869221 1;
BA_ "VFrameFormat" BO_ 929 14;
BA_ "CANFD_BRS" BO_ 929 1;
